## main/Kconfig.projbuild
```kconfig
choice CM_BUILD_EXAMPLE
    prompt "Examples"
    help
        Build the Perseverance-Rover firmware or one of the examples.
    default CM_BUILD_FIRMWARE

    config CM_BUILD_FIRMWARE
        bool "Rover firmware"
endchoice
```
